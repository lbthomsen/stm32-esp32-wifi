## coprocessor/main/Kconfig.projbuild
```kconfig
menu "Coprocessor board"

    config CP_RGB_LED_GPIO
        int "GPIO of the board's WS2812 RGB LED (-1 if none)"
        default -1
        range -1 48
        help
            Many dev boards have a WS2812 RGB LED that can come up lit after a
            reset. If set, the firmware sends it an "off" frame at boot and then
            holds the data line low.

endmenu
```

## coprocessor/sdkconfig.defaults
```kconfig
# ESP-Hosted coprocessor for an STM32 (MCU) host over SPI full duplex.

CONFIG_ESP_HOSTED=y
CONFIG_ESP_HOSTED_CP=y
CONFIG_ESP_HOSTED_CP_FOR_MCU=y
CONFIG_ESP_HOSTED_CP_RPC_V2=y
CONFIG_ESP_HOSTED_CP_FEAT_WIFI=y

# Transport: SPI full duplex, mode 3
CONFIG_EH_TRANSPORT_CP_SPI=y
CONFIG_EH_TRANSPORT_CP_SPI_MODE_3=y
CONFIG_EH_TRANSPORT_CP_SPI_CONTROLLER_HSPI=y

# No BT for now - wifi only
CONFIG_BT_ENABLED=n

CONFIG_ESP_WIFI_ENTERPRISE_SUPPORT=n
CONFIG_ESP_WIFI_NVS_ENABLED=y

# Flash / partitions
CONFIG_ESPTOOLPY_FLASHSIZE_4MB=y
CONFIG_PARTITION_TABLE_CUSTOM=y
CONFIG_PARTITION_TABLE_CUSTOM_FILENAME="partitions_eh_cp_ota_4m.csv"

CONFIG_FREERTOS_HZ=1000
CONFIG_ESP_CACHE_MALLOC=y
CONFIG_COMPILER_OPTIMIZATION_PERF=y
CONFIG_FREERTOS_PLACE_FUNCTIONS_INTO_FLASH=y

CONFIG_ESP_WIFI_STATIC_RX_BUFFER_NUM=10
CONFIG_ESP_WIFI_DYNAMIC_RX_BUFFER_NUM=32
CONFIG_ESP_WIFI_DYNAMIC_TX_BUFFER_NUM=32
CONFIG_ESP_WIFI_AMPDU_TX_ENABLED=y
CONFIG_ESP_WIFI_TX_BA_WIN=16
CONFIG_ESP_WIFI_AMPDU_RX_ENABLED=y
CONFIG_ESP_WIFI_RX_BA_WIN=16
CONFIG_ESP_WIFI_RX_IRAM_OPT=y
CONFIG_ESP_WIFI_IRAM_OPT=y
```

## coprocessor/sdkconfig.defaults.esp32c3
```kconfig
CONFIG_ESP_DEFAULT_CPU_FREQ_MHZ_160=y

# SPI pins (esp-hosted defaults for ESP32-C3)
CONFIG_EH_TRANSPORT_CP_SPI_HSPI_GPIO_MOSI=7
CONFIG_EH_TRANSPORT_CP_SPI_HSPI_GPIO_MISO=2
CONFIG_EH_TRANSPORT_CP_SPI_HSPI_GPIO_CLK=6
CONFIG_EH_TRANSPORT_CP_SPI_HSPI_GPIO_CS=10
CONFIG_EH_TRANSPORT_CP_SPI_GPIO_HANDSHAKE=3
CONFIG_EH_TRANSPORT_CP_SPI_GPIO_DATA_READY=4
CONFIG_EH_TRANSPORT_CP_SPI_GPIO_RESET=-1
```
